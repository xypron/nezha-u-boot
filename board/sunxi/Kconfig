## board/sunxi/Kconfig
```kconfig
config BOARD_SUNXI
	bool
	select BINMAN
	select CLK
	select CMD_GPIO if GPIO
	select CMD_MMC if MMC
	select CMD_USB if DISTRO_DEFAULTS && USB_HOST
	select DM
	select DM_GPIO if GPIO
	select DM_I2C if I2C
	select DM_SCSI if SCSI
	select DM_SERIAL if SERIAL
	select DM_SPI if SPI
	select DM_SPI_FLASH if SPI
	select OF_BOARD_SETUP
	select PINCTRL
	select SPL_SEPARATE_BSS if SPL
	select SUPPORT_SPL
	select SYS_RELOC_GD_ENV_ADDR
	select USB if DISTRO_DEFAULTS
	select USB_KEYBOARD if DISTRO_DEFAULTS && USB_HOST
	select USE_PREBOOT
	imply BOARD_LATE_INIT
	imply CMD_DM
	imply CMD_GPT
	imply CMD_UBI if MTD_RAW_NAND
	imply DISTRO_DEFAULTS
	imply DM_REGULATOR
	imply DM_REGULATOR_FIXED
	imply FAT_WRITE
	imply FIT
	imply OF_LIBFDT_OVERLAY
	imply PRE_CONSOLE_BUFFER
	imply SPL
	imply SPL_GPIO
	imply SPL_LIBCOMMON_SUPPORT
	imply SPL_LIBGENERIC_SUPPORT
	imply SPL_MMC if MMC
	imply SPL_POWER
	imply SPL_SERIAL
	imply SUNXI_GPIO
	imply SYS_I2C_MVTWSI
	imply SYS_NS16550
	imply SYSRESET
	imply SYSRESET_WATCHDOG
	imply SYSRESET_WATCHDOG_AUTO
	imply USB_EHCI_GENERIC
	imply USB_EHCI_HCD
	imply USB_GADGET
	imply USB_OHCI_GENERIC
	imply USB_OHCI_HCD
	imply WDT

if BOARD_SUNXI

config IDENT_STRING
	default " Allwinner Technology"

config PRE_CON_BUF_ADDR
	default 0x81000000 if MACH_SUNIV
	default 0x2f000000 if MACH_SUN9I
	default 0x4f000000 if SUNXI_MINIMUM_DRAM_MB >= 256
	default 0x43000000 if SUNXI_MINIMUM_DRAM_MB >= 64

config SPL_BSS_START_ADDR
	default 0x81f80000 if MACH_SUNIV
	default 0x2ff80000 if MACH_SUN9I
	default 0x4ff80000 if SUNXI_MINIMUM_DRAM_MB >= 256
	default 0x43f80000 if SUNXI_MINIMUM_DRAM_MB >= 64

config SPL_STACK_R_ADDR
	default 0x81e00000 if MACH_SUNIV
	default 0x2fe00000 if MACH_SUN9I
	default 0x4fe00000 if SUNXI_MINIMUM_DRAM_MB >= 256
	default 0x43e00000 if SUNXI_MINIMUM_DRAM_MB >= 64

config SUNXI_MINIMUM_DRAM_MB
	int
	default 32 if MACH_SUNIV
	default 64 if MACH_SUN8I_V3S
	default 256
	help
	  Minimum DRAM size expected on the board. Traditionally we
	  assumed 256 MB, so that U-Boot would load at 160MB. With
	  co-packaged DRAM we have smaller sizes, though, so U-Boot's
	  own load address and the default payload addresses must be
	  shifted down. This is expected to be fixed by the SoC
	  selection.

config SUNXI_SRAM_ADDRESS
	hex
	default 0x10000 if MACH_SUN9I || MACH_SUN50I || MACH_SUN50I_H5
	default 0x20000 if SUN50I_GEN_H6 || SUNXI_GEN_NCAT2
	default 0x0
	help
	  Older Allwinner SoCs have their boot mask ROM mapped just
	  below 4GB, with the first SRAM region located at address 0.
	  Newer SoCs map the boot ROM at address 0 instead and move the
	  SRAM to a different address.

config SYS_BOARD
	default "sunxi"

config SYS_CLK_FREQ
	default  408000000 if MACH_SUNIV
	default 1008000000 if MACH_SUN4I
	default 1008000000 if MACH_SUN5I
	default 1008000000 if MACH_SUN6I
	default  912000000 if MACH_SUN7I
	default 1008000000 if MACH_SUN8I
	default 1008000000 if MACH_SUN8I_R528
	default 1008000000 if MACH_SUN9I
	default  816000000 if MACH_SUN50I || MACH_SUN50I_H5
	default  888000000 if MACH_SUN50I_H6
	default 1008000000 if MACH_SUN50I_H616

config SYS_CONFIG_NAME
	default "suniv"  if MACH_SUNIV
	default "sun4i"  if MACH_SUN4I
	default "sun5i"  if MACH_SUN5I
	default "sun6i"  if MACH_SUN6I
	default "sun7i"  if MACH_SUN7I
	default "sun8i"  if MACH_SUN8I
	default "sun8i"  if MACH_SUN8I_R528
	default "sun9i"  if MACH_SUN9I
	default "sun50i" if MACH_SUN50I
	default "sun50i" if MACH_SUN50I_H6
	default "sun50i" if MACH_SUN50I_H616

config SYS_SOC
	default "sunxi"

menu "sunxi board options"

choice
	prompt "SPL Image Type"
	depends on SPL
	default SPL_IMAGE_TYPE_SUNXI_EGON

config SPL_IMAGE_TYPE_SUNXI_EGON
	bool "eGON (normal)"
	help
	  Select this option to embed the SPL binary in an eGON.BT0 image,
	  which is compatible with the normal boot ROM (NBROM).

	  This is usually the correct option to choose.

config SPL_IMAGE_TYPE_SUNXI_TOC0
	bool "TOC0 (secure)"
	help
	  Select this option to embed the SPL binary in a TOC0 image,
	  which is compatible with the secure boot ROM (SBROM).

endchoice

config SPL_IMAGE_TYPE
	string
	default "sunxi_egon" if SPL_IMAGE_TYPE_SUNXI_EGON
	default "sunxi_toc0" if SPL_IMAGE_TYPE_SUNXI_TOC0

endmenu

endif
```

## configs/devterm_r_01_defconfig
```kconfig
CONFIG_RISCV=y
CONFIG_HAS_CUSTOM_SYS_INIT_SP_ADDR=y
CONFIG_CUSTOM_SYS_INIT_SP_ADDR=0x43e00000
CONFIG_DEFAULT_DEVICE_TREE="sun20i-d1-devterm-v3.14"
CONFIG_TARGET_SUN20I_D1=y
CONFIG_ARCH_RV64I=y
CONFIG_RISCV_SMODE=y
# CONFIG_SPL_SMP is not set
CONFIG_SPL_SYS_MALLOC=y
CONFIG_SPL_OPENSBI_SCRATCH_OPTIONS=0x0
# CONFIG_SYS_I2C_MVTWSI is not set
CONFIG_DRAM_SUN20I_D1=y
CONFIG_DRAM_SUNXI_ODT_EN=0x1
CONFIG_DRAM_SUNXI_TPR0=0x004a2195
CONFIG_DRAM_SUNXI_TPR11=0x00870000
CONFIG_DRAM_SUNXI_TPR12=0x00000024
CONFIG_DRAM_SUNXI_TPR13=0x34050100
```

## configs/iNet_U70B_rev1_defconfig
```kconfig
CONFIG_ARM=y
CONFIG_ARCH_SUNXI=y
CONFIG_DEFAULT_DEVICE_TREE="sun8i-a33-inet-u70b-rev1"
# CONFIG_SPL_SERIAL is not set
CONFIG_SPL=y
CONFIG_MACH_SUN8I_A33=y
CONFIG_DRAM_CLK=480
CONFIG_DRAM_ZQ=31675
CONFIG_DRAM_ODT_EN=y
CONFIG_MMC0_CD_PIN="PB4"
CONFIG_VIDEO_LCD_MODE="x:1024,y:600,depth:18,pclk_khz:51000,le:158,ri:162,up:25,lo:10,hs:20,vs:3,sync:3,vmode:0"
CONFIG_VIDEO_LCD_DCLK_PHASE=0
CONFIG_VIDEO_LCD_POWER="PH7"
CONFIG_VIDEO_LCD_BL_EN="PH6"
CONFIG_VIDEO_LCD_BL_PWM="PH0"
# CONFIG_SYS_MALLOC_CLEAR_ON_INIT is not set
CONFIG_CMD_BIND=y
CONFIG_CMD_CLK=y
CONFIG_CMD_PWM=y
CONFIG_CMD_I2C=y
CONFIG_CMD_WDT=y
CONFIG_CMD_PMIC=y
CONFIG_CMD_REGULATOR=y
# CONFIG_NET is not set
CONFIG_AXP_GPIO=y
CONFIG_REGULATOR_AXP=y
CONFIG_REGULATOR_AXP_USB_POWER=y
CONFIG_AXP_DLDO1_VOLT=3300
CONFIG_DM_PWM=y
CONFIG_PWM_SUNXI=y
# CONFIG_REQUIRE_SERIAL_CONSOLE is not set
CONFIG_USB_MUSB_HOST=y
```

## drivers/ram/sunxi/Kconfig
```kconfig
config RAM_SUNXI
	bool "Ram drivers support for sunxi SoCs"
	depends on RAM && BOARD_SUNXI
	default y
	help
	  This enables support for ram drivers of sunxi SoCs.
```
